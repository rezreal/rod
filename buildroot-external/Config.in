## buildroot-external/Config.in
```kconfig
source "$BR2_EXTERNAL_ROD_PATH/package/rod/Config.in"
source "$BR2_EXTERNAL_ROD_PATH/package/rod-rpi-bt-firmware/Config.in"
```

## buildroot-external/package/rod-rpi-bt-firmware/Config.in
```kconfig
config BR2_PACKAGE_ROD_RPI_BT_FIRMWARE
	bool "rpi-bt-firmware"
	help
	  Broadcom BCM Bluetooth HCD firmware files from RPi-Distro/bluez-firmware.
	  Required so btattach can upload firmware to the onboard BCM chip at boot:
	    RPi 3: BCM43430A1.hcd
	    RPi 4: BCM4345C0.hcd
	    RPi 5: BCM2712D0.hcd (and variants)

	  https://github.com/RPi-Distro/bluez-firmware
```

## buildroot-external/package/rod/Config.in
```kconfig
config BR2_PACKAGE_ROD
	bool "rod"
	depends on BR2_PACKAGE_HOST_RUSTC
	select BR2_PACKAGE_DBUS
	select BR2_PACKAGE_BLUEZ5_UTILS
	help
	  BLE peripheral bridge for IAI linear actuators.
	  Exposes a Handy FW4-compatible GATT service over the onboard
	  Bluetooth radio and drives the actuator via Modbus RTU over USB
	  serial.

	  https://github.com/your-org/rod
```
